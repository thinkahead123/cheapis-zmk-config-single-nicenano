## boards/shields/cheapinov2/Kconfig.defconfig
```kconfig
# Copyright (c) 2022 The ZMK Contributors
# SPDX-License-Identifier: MIT

if SHIELD_CHEAPINOV2

config ZMK_KEYBOARD_NAME
    default "Cheapino v2"
    
endif
```
